## boards/shields.disabled/lotus58-ble/Kconfig.defconfig
```kconfig
if SHIELD_LOTUS58_BLE_LEFT

# Name must be less than 16 characters long!
config ZMK_KEYBOARD_NAME
    default "Lotus58 BLE"

config ZMK_SPLIT_ROLE_CENTRAL
    default y

endif

if SHIELD_LOTUS58_BLE_LEFT || SHIELD_LOTUS58_BLE_RIGHT

config ZMK_SPLIT
    default y

endif

config USB
    default y

config ZMK_USB
    default y

config ZMK_BLE
    default y

config BT
    default y

config BUILD_OUTPUT_UF2
    default y
```

## boards/shields.disabled/lotus58-ble/Kconfig.shield
```kconfig
# Copyright (c) 2022 The ZMK Contributors
# SPDX-License-Identifier: MIT

config SHIELD_LOTUS58_BLE_LEFT
    def_bool $(shields_list_contains,lotus58_ble_left)

config SHIELD_LOTUS58_BLE_RIGHT
    def_bool $(shields_list_contains,lotus58_ble_right)
```
